## config/boards/shields/brolga/kconfig.defconfig
```kconfig
# Copyright (c) 2020 The ZMK Contributors
# SPDX-License-Identifier: MIT

if SHIELD_BROLGA_RIGHT

config ZMK_KEYBOARD_NAME
	default "Brolga"

config ZMK_SPLIT_ROLE_CENTRAL
	default y

endif

if SHIELD_BROLGA_LEFT || SHIELD_BROLGA_RIGHT

config ZMK_SPLIT
	default y

endif
```

## config/boards/shields/brolga/kconfig.shield
```kconfig
# Copyright (c) 2020 The ZMK Contributors
# SPDX-License-Identifier: MIT

config SHIELD_BROLGA_LEFT
	def_bool $(shields_list_contains,brolga_left)

config SHIELD_BROLGA_RIGHT
	def_bool $(shields_list_contains,brolga_right)
```

## config/west.yml
```yaml
manifest:
  remotes:
    - name: zmkfirmware
      url-base: https://github.com/zmkfirmware
    - name: caksoylar
      url-base: https://github.com/caksoylar
    - name: alaasaadabdo
      url-base: https://github.com/alaasaadabdo
  projects:
    - name: zmk
      remote: alaasaadabdo
      revision: alaa
      import: app/west.yml
  self:
    path: config
```
